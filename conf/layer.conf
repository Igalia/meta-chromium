## conf/layer.conf
```bitbake
# We have a conf and classes directory, append to BBPATH
BBPATH .= ":${LAYERDIR}"

# We have a recipes directory, add to BBFILES
BBFILES += "${LAYERDIR}/recipes-*/*/*.bb ${LAYERDIR}/recipes-*/*/*.bbappend"

BBFILE_COLLECTIONS += "chromium-layer"
BBFILE_PATTERN_chromium-layer := "^${LAYERDIR}/"
BBFILE_PRIORITY_chromium-layer = "7"

LAYERVERSION_chromium-layer = "1"
LAYERDEPENDS_chromium-layer = "core openembedded-layer"
LAYERSERIES_COMPAT_chromium-layer = "nanbield"
```
